/* Battery profile extracted from stock m1892 (Meizu 16th Plus) dtbo.img, node qcom,fg-gen3-batterydata-demo-3600mah */
qcom,fg-gen3-batterydata-m1892-3600mah {
	qcom,fastchg-current-ma = <0x1068>;
	qcom,max-voltage-uv = <0x432380>;
	qcom,nom-batt-capacity-mah = <0xe10>;
	qcom,batt-id-kohm = <0x64>;
	qcom,battery-beta = <0xd6b>;
	qcom,battery-name = "ATL-TERM";
	qcom,battery-type = "fg-gen3-batterydata-m1892-3600mah";
	qcom,checksum = <0xaae2>;
	qcom,gui-version = "PMI8998GUI - 2.0.0.58";
	qcom,fg-profile-data = <0x8f1f9405 0x730a4a06 0x271d21ea 0x160a3a0c 0x7189722 0xa53cec4a 0x5c000000 0x10000000 0x43c5 0x92bc89bb 0x11000800 0x69daad07 0x4bfd19fa 0x7e014913 0xebf3783b 0x24060920 0x27001400 0x7e1ff205 0x190aab06 0x6c1db907 0x1a12ff1d 0x6f18eb22 0xb9456f52 0x55000000 0xe000000 0x33cc 0x72cab3c4 0xf000000 0x9300ad07 0x8dfdf600 0x6fe3440b 0xabfcf91b 0xc333ccff 0x7100000 0xa40d9945 0xf004000 0xa4010afa 0xff000000 0x00 0x00 0x00 0x00 0x00 0x00 0x00 0x00 0x00 0x00 0x00 0x00 0x00 0x00 0x00 0x00 0x00 0x00>;
};
