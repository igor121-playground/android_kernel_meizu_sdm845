/* Copyright (c) 2017, The Linux Foundation. All rights reserved.
 *
 * This program is free software; you can redistribute it and/or modify
 * it under the terms of the GNU General Public License version 2 and
 * only version 2 as published by the Free Software Foundation.
 *
 * This program is distributed in the hope that it will be useful,
 * but WITHOUT ANY WARRANTY; without even the implied warranty of
 * MERCHANTABILITY or FITNESS FOR A PARTICULAR PURPOSE.  See the
 * GNU General Public License for more details.
 */

/* Meizu 16th Plus (m1892): same msm-id/board-id as 16th (m1882), differs only in peripherals */
#define MZ_M1892 1

/dts-v1/;

#include "sdm845-v2.1.dtsi"
#include "meizu/sdm845-meizu.dtsi"

/ {
	model = "Qualcomm Technologies, Inc. SDM845 v2.1 SoC";
	compatible = "qcom,sdm845";
	qcom,board-id = <0 0>;
};

